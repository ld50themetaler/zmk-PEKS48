## config/west.yml
```yaml
manifest:
  remotes:
    - name: zmkfirmware
      url-base: https://github.com/zmkfirmware
    - name: powerenterkey
      url-base: https://github.com/PowerEnterKey
    - name: caksoylar  # RGB LED
      url-base: https://github.com/caksoylar  
    - name: badjeff    # PMW3610
      url-base: https://github.com/badjeff
    - name: prospector
      url-base: https://github.com/t-ogura
  projects:
    - name: zmk
      remote: zmkfirmware
      revision: v0.3
      import: app/west.yml
    - name: zmk-rgbled-widget
      remote: caksoylar
      revision: v0.3
    - name: zmk-pmw3610-driver
      remote: badjeff
      revision: zmk-0.3
    - name: prospector-zmk-module
      remote: prospector
      revision: v2.2b
      path: modules/prospector-zmk-module
  self:
    path: config
```
